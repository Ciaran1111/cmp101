#include <Arduino.h>
#include <DS3231.h>
#include <Streaming.h>
#include <SPI.h>
#include <Wire.h>
#include <iomanip>
#include <Adafruit_GFX.h>
#include <Adafruit_SSD1306.h>
#include <String.h>


// OLED stuff
#define OLED_RESET -1
#define OLED_SCREEN_I2C_ADDRESS 0x3C
Adafruit_SSD1306 display(OLED_RESET);

// 7 SEG STUFF
#include <InvertedTM1638.h>
#include <TM1638.h>
#include <TM1638QYF.h>
#include <TM1640.h>
#include <TM16XX.h>
#include <TM16XXFonts.h>
#define TM1638_STB D5
#define TM1638_CLK D6
#define TM1638_DIO D7
TM1638 module(TM1638_DIO, TM1638_CLK, TM1638_STB);


// rtc 
DS3231 rtc;
bool h12 = true;
bool PM = true;
RifTime t;
char buffer[24];

//clock variables
byte hour;
byte minute;
byte second;
byte year;
byte month;
byte day;
byte weekday;
byte date;
float temp;

// wifi 
#include <ESP8266WiFi.h>
#include <WiFiClient.h>
#include <ESP8266WebServer.h>

const char *ssid = "ArduinoClock"; // Set it to something unique
const char *password = "CiaransAlarm"; // MUST be at least 8 chars
ESP8266WebServer server(80);


String dateAL = " ";
String str_dayAL = " ";
String str_hourAL = " ";
String str_minAL = " ";

int dayAL = 0;
int hourAL = 0;
int minAL = 0;

bool alarm = false;
void handleRoot() {
 server.send(200, "text/html", "<h1>You are connected</h1>");
}


// 'logo---copy', 128x64px
const unsigned char myBitmap [] PROGMEM = {
  0xff, 0xff, 0xff, 0xff, 0xc0, 0x00, 0x00, 0x00, 0x00, 0x00, 0x00, 0x3f, 0xff, 0xff, 0xff, 0xff, 
  0xff, 0xff, 0xff, 0xff, 0x80, 0x00, 0x00, 0x00, 0x00, 0x00, 0x00, 0x1f, 0xff, 0xff, 0xff, 0xff, 
  0xff, 0xff, 0xff, 0xff, 0x80, 0x00, 0x00, 0x00, 0x00, 0x00, 0x00, 0x1f, 0xff, 0xff, 0xff, 0xff, 
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  0xff, 0xfe, 0x00, 0x00, 0x00, 0x00, 0x00, 0x00, 0x00, 0x00, 0x00, 0x00, 0x00, 0x00, 0x1f, 0xff
};


// contrast function to allow for changing of OLED screen brightness
void setContrast(Adafruit_SSD1306 *display, uint8_t contrast)
{
    display->ssd1306_command(SSD1306_SETCONTRAST);
    display->ssd1306_command(contrast);
}




void setup() {


  
  // put your setup code here, to run once:
Serial.begin(115200);
Wire.begin();
noTone(D7);
//oled setup
display.begin(SSD1306_SWITCHCAPVCC, OLED_SCREEN_I2C_ADDRESS);
 display.display();
 delay(2000);
 display.clearDisplay();
 display.setCursor(0,0);
 display.setTextSize(1); // - a line is 21 chars in this size
 display.setTextColor(WHITE);
 
 // set up the 7 seg display
 module.clearDisplay();
 module.setupDisplay(true, 3);

// drawing personal Logo to screen for 5 seconds
 display.drawBitmap(0,0, myBitmap, 128, 64, WHITE);
display.display();
delay(5000);

// start up animation on LED lights on 7 Seg
for (int i = 0; i < 256; i++){
  delay(10);
  module.setLEDs(0x0000000 + i);
 }
delay(1000);
module.setLEDs(0b11111111);
delay(500);
module.setLEDs(0x0000000);
delay(500);
module.setLEDs(0b1111111);

// wifi startup 
 WiFi.softAP(ssid, password);
 IPAddress myIP = WiFi.softAPIP();
 Serial.print("AP IP address: ");
 Serial.println(myIP);
 server.on("/", handleRoot);
 
server.on("/date", []() {
  
  
  // reading in date from user (via wifi)
  String dateAL = server.arg("date");
  //str_dayAL = dateAL.substring(0,2);

  // substringing this to hours and mins  
  str_hourAL = dateAL.substring(0,2);
  str_minAL = dateAL.substring(2,4);

  // converting it to an int so it can be used in logical comparrisions 
  hourAL = str_hourAL.toInt();
  minAL = str_minAL.toInt();

 server.send(200, "text/plain", "Alarm is now set!");
 pinMode(D7, OUTPUT);

 });

server.begin();
 Serial.println("HTTP server started");

noTone(D7);
 
}


// Main loop
void loop() {

;
module.setDisplayToDecNumber(rtc.getDate(),0,false);

 server.handleClient();

// outputs the current hours and mins of the alarm to serial ( used a lot in bug testing) 
 Serial << hourAL << minAL << endl;  // was used for testing if the input was being taken in from webserver



  // read input from analog  nob 
 int sensorValue = analogRead(A0);

// module.setDisplayToDecNumber(sensorValue, 0, false); - was used to figure if the nob was working as intended originally

 
  display.clearDisplay();
 display.setCursor(0,0);

 
 rtc.getTime(t);

  display << "The current time is:";
  display << " ";

   if (rtc.getHour(h12,PM) < 9 && rtc.getMinute() < 9)
   {
     display << '0' << rtc.getHour(h12, PM) << ':' << '0' << rtc.getMinute() << ':' << rtc.getSecond();
   }
   else {
    display << rtc.getHour(h12, PM) << ':' << rtc.getMinute() << ':' << rtc.getSecond();
   }

  if (rtc.getHour(h12,PM) == hourAL && rtc.getMinute() == minAL)
   {
     alarm = true;
   }

  if (alarm == true){
      display.clearDisplay();
      display << "Wake up";
      
      module.setLEDs(0b11111111);
      tone(D7, 150, 200);
      delay(500);
      module.setLEDs(0x0000000);
       noTone(D7); 
      delay(2000);
      module.setLEDs(0b1111111);
  }

  if (alarm = false){
  noTone(D7); 
  }
  if (module.getButtons() > 0){
  alarm = false;
  hourAL = 9999;
  minAL = 9999;
  display.clearDisplay();
  }
   
   display << "              ";
   display << "The current tempature is: " << rtc.getTemperature();

    

  // BRIGHTNESS CHANGING USING NOB THING 
  if (sensorValue <= 146){
    module.setupDisplay(true, 1);
    setContrast(&display, 0);
  } else if (sensorValue > 146 && sensorValue <= 292){
    module.setupDisplay(true, 2);
    setContrast(&display, 64);
  } else if (sensorValue > 292 && sensorValue <= 408){
    module.setupDisplay(true, 3);
  } else if (sensorValue > 408 && sensorValue <= 554){
    module.setupDisplay(true, 4);
    setContrast(&display, 128);
  } else if (sensorValue > 554 && sensorValue <= 700){
    module.setupDisplay(true, 5);
  } else if (sensorValue > 700 && sensorValue <= 846){
    module.setupDisplay(true, 6);
  } else if (sensorValue > 846 && sensorValue <= 1024){
    module.setupDisplay(true, 7);
    setContrast(&display, 255);
  }



   delay( 1000);


 //remove this code and the above text will not show
 display.display();


}
